$NOLIST                         ; исключение последующего текста из файла листинга
$NOMOD51                        ; "отключаем" стандартный '51'
$INCLUDE (ADuC814.inc)          ; адреса и константы ADuC814
$LIST                           ; включение последующего текста в файл листинга

XOUT    EQU     P1.0
YOUT    EQU     P1.1

LNG_ONE EQU     8               ; 8 байт на один замер
NUM_MEA EQU     4               ; количество замеров в буфере


DSEG 
        ORG     0030H
BUFF:   DS      LNG_ONE*NUM_MEA ; буфер 'NUM_MEA' замеров
RESULT: DS      LNG_ONE         ; результат "усреднения"
CNT_M:  DS      1               ; счетчик замеров

CSEG
        ORG     0               ; нижеследующая команда с адреса 0

        LJMP    START           ; на команду метки START

        ORG     100H            ; нижеследующая команда с адреса 100Н

START:                          ; программа

        MOV     IE,#0           ; все прерывания запрещены

; настройка синтезатора (datasheet ADuC814)

        MOV     PLLCON,#01H     ; синтезатор рабочей частоты ядра
                                ; Core Clk = XTALL*256 = 32768*256 = 8388608 герц

; настройка сторожевого таймера (datasheet ADuC814)

        SETB    WDWR            ; разрешение записи в 'WDCON'
        MOV     WDCON,#72H;     ; запуск WDT с временным интервалом 2с

; настройка UART

        MOV     SCON,#40h       ; настройка последовательного порта на 
                                ; асинхронный 8-битовый режим

; настройка Т/С0

        MOV     TMOD,#01h       ; T/C0 - таймер

; настройка Т/С2

        MOV     RCAP2H,#0FFh    ; задание скорости 9600 бод 
        MOV     RCAP2L,#0E5h    ; (814code_asm)
        MOV     TH2,#0FFh        
        MOV     TL2,#0E5h  
        MOV     T2CON,#30h      ; установка Т/С2 в качестве генератора скорости UART
        SETB    TR2             ; запуск генератора скорости 'UART'

; начальные значения переменных

        MOV     R0,#CNT_M
        MOV     A,#0
        MOV     @R0,A           ; счетчик замеров = '0'


MAIN:                           ; главный цикл программы             
        CALL    MEASUREMENT     ; значение 'RO..R7'='X|Y'
        ;
        MOV     R0,#CNT_M       ; в р е м е н н о !!!
        MOV     A,@R0           ; указатель на замер
        ;
        CALL    OUT_DATA        ; замер на вывод

; сброс сторожевого таймера (814code_asm)

        CLR     EA
        SETB    WDWR
        SETB    WDE
        SETB    EA

        LJMP    MAIN            ; на следущее измерение



;---------------------------------------------------------------------------------
;---------------=: Подпрограммы :=------------------------------------------------
;---------------------------------------------------------------------------------
; одно измерение 'X|Y'
MEASUREMENT:

        MOV     TH0,#0          ; сброс T0 
        MOV     TL0,#0

; измерение длительности и периода импульсов с выходов Xout и Yout

        JNB     XOUT,$          ; ожидание фронта 1-го импульса с выхода Xout
        SETB    TR0             ; запуск T0

        JB      XOUT,$          ; ожидание спада 1-го импульса с выхода Xout
        MOV     A,TL0           ; в R1R0 - значение спада 1-го импульса с выхода Xout
        MOV     R0,A
        MOV     A,TH0
        MOV     R1,A            ; 'RO|R1' -  -= ДЛИТЕЛЬНОСТЬ ИМПУЛЬСА 'X' =-  

        JNB     XOUT,$          ; ожидание фронта 2-го импульса с выхода Xout
        MOV     A,TL0           ; в R3R2 - значение фронта 2-го импульса с выхода Xout
        MOV     R2,A
        MOV     A,TH0
        MOV     R3,A            ; 'R2|R3' -  -= ПЕРИОД ИМПУЛЬСА 'X' =-  

        CLR     TR0             ; останов T0                  
        MOV     TH0,#0          ; сброс T0
        MOV     TL0,#0
         
        JNB     YOUT,$          ; ожидание фронта 1-го импульса с выхода Yout
        SETB    TR0             ; запуск T0

        JB      YOUT,$          ; ожидание спада 1-го импульса с выхода Yout
        MOV     A,TL0           ; в R5R4 - значение спада 1-го импульса с выхода Yout
        MOV     R4,A
        MOV     A,TH0
        MOV     R5,A            ; 'R4|R5' -  -= ДЛИТЕЛЬНОСТЬ ИМПУЛЬСА 'Y' =- 

        JNB     YOUT,$          ; ожидание фронта 2-го импульса с выхода Yout
        MOV     A,TL0           ; в R7R6 - значение фронта 2-го импульса с выхода Yout
        MOV     R6,A
        MOV     A,TH0
        MOV     R7,A            ; 'R6|R7' -  -= ПЕРИОД ИМПУЛЬСА 'Y' =- 

        CLR     TR0             ; останов T0

; сохраняем замер в буфере

        MOV     A,R0
        MOV     DPL,A
        MOV     A,R1
        MOV     DPH,A           ; сохраним 'R0|R1'
        MOV     R0,#CNT_M
        MOV     A,@R0
        MOV     R1,A            ; R1=A='счетчик замеров'
        MOV     R0,#BUFF
        JZ      ME2             ; если первый ('0') замер
ME1:
        MOV     A,#LNG_ONE      ; "длина" одного замера
        ADD     A,R0
        MOV     R0,A            ; смещаемся на один замер      
        DJNZ    R1,ME1
; начинаем освобождать 'R0-R7', размещая в буфере
ME2:
        MOV     A,DPL
        MOV     @R0,A           ; 'R0'
        INC     R0
        MOV     A,DPH
        MOV     @R0,A           ; 'R1'
        INC     R0
        MOV     A,R2
        MOV     @R0,A           ; 'R2'
        INC     R0
        MOV     A,R3
        MOV     @R0,A           ; 'R3'
        INC     R0
        MOV     A,R4
        MOV     @R0,A           ; 'R4'
        INC     R0
        MOV     A,R5
        MOV     @R0,A           ; 'R5'
        INC     R0
        MOV     A,R6
        MOV     @R0,A           ; 'R6'
        INC     R0
        MOV     A,R7
        MOV     @R0,A           ; 'R7'
        RET

;---------------------------------------------------------------------------------
; посылка результатов замеров ('ID'/'R0-R7'/'CC') [A=указатель на замер]:
OUT_DATA:
        MOV     R1,A            ; R1 = номер замера
        MOV     R0,#BUFF
        JZ      OD2             ; если первый ('0') замер
OD1:
        MOV     A,#LNG_ONE      ; "длина" одного замера
        ADD     A,R0
        MOV     R0,A            ; смещаемся на один замер      
        DJNZ    R1,OD1
OD2:
        MOV     A,#5Ah          ; метка начала блока данных
        MOV     B,A             ; начальное значение контрольной суммы
        CALL    TX_BYTE         ; передача начального значения контрольной суммы
        MOV     R1,#LNG_ONE        
OD3:
        MOV     A,@R0  
        CALL    TX_BYTE         ; передача байта замера из буфера
        ADD     A,B      
        MOV     B,A
        INC     R0
        DJNZ    R1,OD3
        CALL    TX_BYTE         ; передача конечного значения контрольной суммы

        RET

;---------------------------------------------------------------------------------
; передача байта через 'UART'
TX_BYTE:
        MOV     SBUF,A          ; начать передачу байта   
        JNB     TI,$            ; ожидание передачи байта
        CLR     TI              ; бит должен быть очищен перед следующей передачей
        RET

        END

; ----------------------------------------------------------
; Baud Rate = 9600
; Baud Rate = (Core Clk)/(32*[65535-(RCAP2H, RCAP2L)])
; RCAP2H, RCAP2L = 65536-(Core Clk/(32*Baud Rate)) = #0FFE5h
; ----------------------------------------------------------
; Таймер-0: исп-ся для замера временных интервалов
; Таймер-2: исп-ся для установки скорости 'UART'
; ----------------------------------------------------------

; -------------------------------------
; Регистр    SCON     TMOD      T2CON     
; -------    -----    ------    ------
;  Бит-7     SM0-0    GAT1-0     TF2-0
;  Бит-6     SM1-1    C/T1-0    EXF2-0
;  Бит-5     SM2-0    M1.1-0    RCLK-1
;  Бит-4     REN-0    M0.1-0    TCLK-1

;  Бит-3     TB8-0    GAT0-0   EXEN2-0
;  Бит-2     RB8-0    C/T0-1     TR2-0
;  Бит-1      TI-0    M1.0-0    CNT2-0
;  Бит-0      RI-0    M0.0-1    CAP2-0
; ------------------------------------

