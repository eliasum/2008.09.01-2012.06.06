;********************************************************************************
;*                                                                              *
;*                       Управляющая программа для 'ADXL202'                    *
;*                           Версия 0.0 (7 июня 2009 г)                         *
;*                                                                              *
;********************************************************************************

$NOLIST                         ; исключение последующего текста из файла листинга
$NOMOD51                        ; "отключаем" стандартный '51'
$INCLUDE (ADuC814.inc)          ; адреса и константы ADuC814
$LIST                           ; включение последующего текста в файл листинга

XOUT    EQU     P1.0
YOUT    EQU     P1.1

        ORG     0               ; нижеследующая команда с адреса 0

        LJMP    START           ; на команду метки START

        ORG     100H            ; нижеследующая команда с адреса 100Н

START:                          ; программа

        MOV     IE,#0           ; все прерывания запрещены

; настройка синтезатора (datasheet ADuC814)

        MOV     PLLCON,#01H     ; синтезатор рабочей частоты ядра
                                ; Core Clk = XTALL*256 = 32768*256 = 8388608 герц

; настройка сторожевого таймера (datasheet ADuC814)

        SETB    WDWR            ; разрешение записи в 'WDCON'
        MOV     WDCON,#72H;     ; запуск WDT с временным интервалом 2с

; настройка UART

        MOV     SCON,#40h       ; настройка последовательного порта на 
                                ; асинхронный 8-битовый режим							
; настройка Т/С0

        MOV     TMOD,#01h       ; T/C0 - таймер
											   
; настройка Т/С2

        MOV     RCAP2H,#0FFh    ; задание скорости 9600 бод 
        MOV     RCAP2L,#0E5h    ; (814code_asm)
        MOV     TH2,#0FFh        
        MOV     TL2,#0E5h  
        MOV     T2CON,#30h      ; установка Т/С2 в качестве генератора скорости UART
        SETB    TR2             ; запуск генератора скорости 'UART'

MAIN:                           ; главный цикл программы             

        MOV     TH0,#0          ; сброс T0 
        MOV     TL0,#0

; измерение длительности и периода импульсов с выходов Xout и Yout

X_K1:   JB      XOUT,X_K1       ; корректировка расчета длительности импульсов с выхода Xout

X_F:    JNB     XOUT,X_F        ; ожидание фронта 1-го импульса с выхода Xout      	
	    SETB    TR0             ; запуск T0
		
X_S:    JB      XOUT,X_S        ; ожидание спада 1-го импульса с выхода Xout
	  	CLR     TR0             ; останов T0                  

        MOV     A,TL0           ; в R1R0 - значение длительности импульсов с выхода Xout
        MOV     R0,A
        MOV     A,TH0
        MOV     R1,A

        MOV     TH0,#0          ; сброс T0
        MOV     TL0,#0

X_K2:   JB      XOUT,X_K2       ; корректировка расчета периода импульсов с выхода Xout

X_F2:   JNB     XOUT,X_F2       ; ожидание фронта 2-го импульса с выхода Xout
	    SETB    TR0             ; запуск T0

X_S2:   JB      XOUT,X_S2       ; ожидание спада 2-го импульса с выхода Xout
X_F3:   JNB     XOUT,X_F3       ; ожидание фронта 3-го импульса с выхода Xout
		CLR     TR0             ; останов T0

        MOV     A,TL0           ; в R3R2 - значение периода импульсов с выхода Xout
        MOV     R2,A
        MOV     A,TH0
        MOV     R3,A
              
        MOV     TH0,#0          ; сброс T0
        MOV     TL0,#0

Y_K3:   JB      YOUT,Y_K3       ; корректировка расчета длительности импульсов с выхода Yout 

Y_F:    JNB     YOUT,Y_F        ; ожидание фронта 1-го импульса с выхода Yout      	
	    SETB    TR0             ; запуск T0
		
Y_S:    JB      YOUT,Y_S        ; ожидание спада 1-го импульса с выхода Yout
        CLR     TR0             ; останов T0                  

        MOV     A,TL0           ; в R5R4 - значение длительности импульсов с выхода Yout
        MOV     R4,A
        MOV     A,TH0
        MOV     R5,A

        MOV     TH0,#0          ; сброс T0
        MOV     TL0,#0

Y_K4:   JB      XOUT,Y_K4       ; корректировка расчета периода импульсов с выхода Yout

Y_F2:   JNB     YOUT,Y_F2       ; ожидание фронта 2-го импульса с выхода Yout
	    SETB    TR0             ; запуск T0

Y_S2:   JB      YOUT,Y_S2       ; ожидание спада 2-го импульса с выхода Yout
Y_F3:   JNB     YOUT,Y_F3       ; ожидание фронта 3-го импульса с выхода Yout
        CLR     TR0             ; останов T0

        MOV     A,TL0           ; в R7R6 - значение периода импульсов с выхода Yout
        MOV     R6,A
        MOV     A,TH0
        MOV     R7,A

; посылка результатов замеров:

        MOV     A,#5Ah          ; метка начала блока данных
        MOV     B,A             ; начальное значение контрольной суммы

        CALL    TX_BYTE         ; передача начального значения контрольной суммы

        MOV     A,R0  
        CALL    TX_SUM          ; передача содержимого регистра R0
         
        MOV     A,R1  
        CALL    TX_SUM          ; передача содержимого регистра R1
         
        MOV     A,R2  
        CALL    TX_SUM          ; передача содержимого регистра R2
          
        MOV     A,R3  
        CALL    TX_SUM          ; передача содержимого регистра R3
         
        MOV     A,R4  
        CALL    TX_SUM          ; передача содержимого регистра R4
          
        MOV     A,R5  
        CALL    TX_SUM          ; передача содержимого регистра R5
          
        MOV     A,R6  
        CALL    TX_SUM          ; передача содержимого регистра R6
         
        MOV     A,R7  
        CALL    TX_BYTE         ; передача содержимого регистра R7
        ADD     A,B      
	
        CALL    TX_BYTE         ; передача конечного значения контрольной суммы
	   
; сброс сторожевого таймера (814code_asm)

        CLR     EA
        SETB    WDWR
        SETB    WDE
        SETB    EA

        LJMP    MAIN            ; на следущее измерение

;---------------Подпрограммы---------------

; передача байта через 'UART'

TX_BYTE:
        MOV     SBUF,A          ; начать передачу байта   
        JNB     TI,$            ; ожидание передачи байта
        CLR     TI              ; бит должен быть очищен перед следующей передачей
        RET

; передача байта и коррекция контрольной суммы

TX_SUM:      
        CALL    TX_BYTE
        ADD     A,B      
        MOV     B,A
        RET

        END

; ----------------------------------------------------------
; Baud Rate = 9600
; Baud Rate = (Core Clk)/(32*[65535-(RCAP2H, RCAP2L)])
; RCAP2H, RCAP2L = 65536-(Core Clk/(32*Baud Rate)) = #0FFE5h
; ----------------------------------------------------------
; Таймер-0: исп-ся для замера временных интервалов
; Таймер-2: исп-ся для установки скорости 'UART'
; ----------------------------------------------------------

; -------------------------------------
; Регистр    SCON     TMOD      T2CON     
; -------    -----    ------    ------
;  Бит-7     SM0-0    GAT1-0     TF2-0
;  Бит-6     SM1-1    C/T1-0    EXF2-0
;  Бит-5     SM2-0    M1.1-0    RCLK-1
;  Бит-4     REN-0    M0.1-0    TCLK-1

;  Бит-3     TB8-0    GAT0-0   EXEN2-0
;  Бит-2     RB8-0    C/T0-0     TR2-0
;  Бит-1      TI-0    M1.0-0    CNT2-0
;  Бит-0      RI-0    M0.0-1    CAP2-0
; ------------------------------------

